## drivers/michal/Kconfig
```kconfig
# SPDX-License-Identifier: GPL-2.0-only
#
# michal drivers configuration
#

menu "Michal drivers"

config MICHAL_DRIVERS
	bool "Michal drivers"
	help 
	  Say Y here to enable Michal drivers

if MICHAL_DRIVERS

config MI_FAN_PWM
	tristate "Michal fan driver"
	help
          PWM control of a fan

          If unsure, say N.

          To comple this driver as a module, choose M here: the
          module will be called mi_fan_pwm

config MI_THERMAL_SIMULATOR
	tristate "Michal thermal simulator driver driver
	help
	  Simulates a thermal sensor by letting an user to set temp from sysfs

	  If unsure, say N.

	  To comple this driver as a module, choose M here: the
	  module will be called mi_thermal_simulator
endif

endmenu
```

## drivers/michal/from_linux-internal/Kconfig
```kconfig
# SPDX-License-Identifier: GPL-2.0-only
#
# michal drivers configuration
#
menuconfig MICHAL_DRIVERS
	bool "Michal drivers"
	help 
	  Say Y here to enable Michal drivers

if MICHAL_DRIVERS

config MI_I2C
	tristate "Michal i2c test driver"
	help
	  Practice driver from scratch

	  If unsure, say N.
 
 	  To comple this driver as a module, choose M here: the
	  module will be called mi_i2c .


endif
```

## drivers/michal/mi_fan_pwm/Kconfig
```kconfig
# SPDX-License-Identifier: GPL-2.0-only
#
# michal drivers configuration
#
if MICHAL_DRIVERS

menu "Michal fan support"

config MI_FAN_PWM
	tristate "Michal fan driver"
	help
	  PWM control of a fan

	  If unsure, say N.
 
 	  To comple this driver as a module, choose M here: the
	  module will be called mi_fan_pwm

endmenu
endif
```
